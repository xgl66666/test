
SYSTEM.DOWN 
System.cpu MIPS4K
SYSTEM.JTAGCLOCK 20.0MHz
system.mode NODEBUG
system.mode ATTACH
LOCAL &objname &topath &ext
ENTRY &objname

&topath="Y:\build\bin\"
&ext=".out"
IF ("&objname"=="comedia")
(
;  RESOURCE IN RAM
;  SYStem.Option MonBase 0x80201100
;  RESOURCE NOT IN RAM
  SYStem.Option MonBase 0x80001100
)
ELSE IF ("&objname"=="chalvalidator")
(
  SYStem.Option MonBase 0x80001f00
)
ELSE IF ("&objname"=="dalts")
(
  SYStem.Option MonBase 0x80401800
)
ELSE IF ("&objname"=="keltic_ecos")
(
  SYStem.Option MonBase 0x83000000
  &topath="Y:\sdk\mstar_5c59_kaon\src\DDI_Misc\cus_mstar\project\mstar_demo\bin\"
  &ext=".elf"
)

SYStem.Option TURBO ON
break
;data.load Y:\CSO_TEST_PK_2005_10000.bin 0x83fff000 
data.load.elf &topath&objname&ext
data.load.elf &topath&objname&ext
data.load.elf &topath&objname&ext /STRIPPART 5 /PATH Y:\ /NOCODE 

;Debugger stops on exception, break point set	50
Break.Set __default_exception_vsr

ENDDO
